## firmware/sdkconfig.defaults
```kconfig
# ESP32-S3-BOX-3 target defaults (see esp-box examples)

CONFIG_IDF_TARGET="esp32s3"

# Flash (16MB Quad on BOX-3 — DIO at runtime; QIO breaks spi_flash_mmap on IDF 5.4.1)
CONFIG_ESPTOOLPY_FLASHMODE_DIO=y
CONFIG_ESPTOOLPY_FLASHSIZE_16MB=y

# Octal PSRAM (required on BOX-3 — flash/PSRAM share MSPI bus)
CONFIG_SPIRAM=y
CONFIG_SPIRAM_MODE_OCT=y
CONFIG_SPIRAM_SPEED_80M=y
CONFIG_SPIRAM_MALLOC_ALWAYSINTERNAL=4096
CONFIG_SPIRAM_MALLOC_RESERVE_INTERNAL=81920
CONFIG_SPIRAM_TRY_ALLOCATE_WIFI_LWIP=y
CONFIG_SPIRAM_USE_MALLOC=y

# WiFi — keep internal heap headroom for upload + playback
CONFIG_ESP_WIFI_STATIC_RX_BUFFER_NUM=8
CONFIG_ESP_WIFI_DYNAMIC_RX_BUFFER_NUM=16
CONFIG_ESP_WIFI_STATIC_TX_BUFFER_NUM=8
CONFIG_ESP_WIFI_CACHE_TX_BUFFER_NUM=16
CONFIG_ESP_WIFI_MGMT_SBUF_NUM=16
CONFIG_ESP_WIFI_RX_BA_WIN=6

# LWIP — fewer concurrent TCP buffers
CONFIG_LWIP_MAX_SOCKETS=8
CONFIG_LWIP_MAX_ACTIVE_TCP=8
CONFIG_LWIP_MAX_LISTENING_TCP=4
CONFIG_LWIP_TCP_SND_BUF_DEFAULT=4096
CONFIG_LWIP_TCP_WND_DEFAULT=4096

# Cache (BOX-3 / octal PSRAM)
CONFIG_ESP32S3_INSTRUCTION_CACHE_32KB=y
CONFIG_ESP32S3_DATA_CACHE_64KB=y
CONFIG_ESP32S3_DATA_CACHE_LINE_64B=y

# Main task (Wi-Fi + HTTP bootstrap needs >3584 default)
CONFIG_ESP_MAIN_TASK_STACK_SIZE=8192

# Console
CONFIG_ESP_CONSOLE_USB_SERIAL_JTAG=y
CONFIG_ESP_CONSOLE_SECONDARY_NONE=y

# Partition (0x10000 aligns with 64KB MMU pages — avoids mmap fault on BOX-3)
CONFIG_PARTITION_TABLE_OFFSET=0x10000
CONFIG_PARTITION_TABLE_CUSTOM=y
CONFIG_PARTITION_TABLE_CUSTOM_FILENAME="partitions.csv"
CONFIG_BOOTLOADER_APP_ROLLBACK_ENABLE=y

# LVGL: smaller line buffer; full draw buffer is allocated in PSRAM at runtime
CONFIG_BSP_LCD_DRAW_BUF_HEIGHT=40
CONFIG_LV_USE_CLIB_MALLOC=y
CONFIG_LV_USE_CLIB_STRING=y
CONFIG_LV_USE_CLIB_SPRINTF=y
```
